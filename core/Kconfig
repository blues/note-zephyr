## core/hooks/Kconfig
```kconfig
config BLUES_NOTECARD_HOOKS_HEAP_TIMEOUT
	int "Allocation Timeout in ms"
	default 10
	help
	  Set Allocation Timeout in milliseconds

config BLUES_NOTECARD_HOOKS_HEAP_SIZE
	int "Allocation Heap total size"
	default 16384
	help
	  Set Total Heap size reserved for Blues Notecard
```

## notecard/hooks/Kconfig
```kconfig
# Copyright (c) 2025 Blues Inc.
# SPDX-License-Identifier: MIT

config BLUES_NOTECARD_HOOKS_HEAP_TIMEOUT
	int "Allocation Timeout in ms"
	default 10
	help
	  Set Allocation Timeout in milliseconds

config BLUES_NOTECARD_HOOKS_HEAP_SIZE
	int "Allocation Heap total size"
	default 16384
	help
	  Set Total Heap size reserved for Blues Notecard

config BLUES_NOTECARD_LOGGING
	bool "Enable Notecard messages logging"
	default y
	help
	  Enable Notecard debug logging

config BLUES_NOTECARD_I2C_MUTEX
	bool "Enable I2C mutex protection"
	default y
	help
	  Enable mutex protection for I2C operations
```

## west.yml
```yaml
# ONLY FOR LOCALLY BUILDING NOTE-ZEPHYR
manifest:
  projects:
    - name: zephyr
      revision: main
      url: https://github.com/zephyrproject-rtos/zephyr
      import:
        name-allowlist:
          - cmsis_6
          - hal_stm32
```
