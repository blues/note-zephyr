## CMakeLists.txt
```
zephyr_include_directories_ifdef(CONFIG_BLUES_NOTECARD note-c)
add_subdirectory_ifdef(CONFIG_BLUES_NOTECARD notecard)
```

## KConfig
```
config NOTECARD
    bool "Enable the helper library for the Blues Wireless Notecard"
    default n
    depends on I2C
    help
      Module for controlling blues.io notecard using the note-c library. Requires an device tree alias for the notecard.
```

## Kconfig
```
# Copyright (c) 2019 Nordic Semiconductor ASA
# SPDX-License-Identifier: Apache-2.0

config USB_DEVICE_PID
#	default USB_PID_CONSOLE_SAMPLE
	default 0x0004

source "Kconfig.zephyr"
```

## Kconfig.blues
```
menuconfig BLUES_NOTECARD
	bool "Enable Blues Notecard libraries"
	help
	  Enable Blues Notecard Libraries to communicate with the Notecard
```

## Kconfig.notecard
```
menuconfig BLUES_NOTECARD
	select REQUIRES_STD_C11
	bool "Enable Blues Notecard libraries"
	help
	  Enable Blues Notecard Libraries to communicate with the Notecard (requires C11)

if BLUES_NOTECARD
config BLUES_NOTEHUB_PRODUCT_UID
	string "Notehub Product UID"
	default ""
	help
	  The Product UID for your Notehub project.
	  Leave empty if you want to set this programmatically.
	  See https://dev.blues.io/notehub/notehub-walkthrough/#finding-a-productuid for more information.

rsource "notecard/Kconfig"
endif # BLUES_NOTECARD
```

## prj.conf
```kconfig
# Provides access to onboard LED
CONFIG_GPIO=y

# Notecard Communication Channel
CONFIG_I2C=y
CONFIG_SERIAL=y

# Required by `note-c`
CONFIG_NEWLIB_LIBC=y

# Debugging Configuration
CONFIG_PRINTK=y
```

## app.overlay
```dts
/*
 * Copyright (c) 2021 Nordic Semiconductor ASA
 *
 * SPDX-License-Identifier: Apache-2.0
 */

&clk_hsi48 {
	#clock-cells = <0>;
	compatible = "fixed-clock";
	clock-frequency = <DT_FREQ_M(48)>;
	status = "okay";
};

&zephyr_udc0 {
	cdc_acm_uart0: cdc_acm_uart0 {
		compatible = "zephyr,cdc-acm-uart";
		label = "CDC_ACM_0";
	};
};
```

## dts/bindings/modem/blues,notecard-i2c.yaml
```yaml
description: Blues Notecard Modem
compatible: "blues,notecard"
include: i2c-device.yaml
```

## dts/bindings/modem/blues,notecard-uart.yaml
```yaml
description: Blues Notecard Modem
compatible: "blues,notecard"
include: uart-device.yaml
```

## src/main.c
```c
/*
 * Copyright (c) 2023 Blues Inc.
 *
 * MIT License. Use of this source code is governed by licenses granted
 * by the copyright holder including that found in the LICENSE file.
 *
 * Author: Zachary J. Fields
 */

// Include Zephyr Headers
#include <zephyr/drivers/gpio.h>
#include <zephyr/kernel.h>

// Include Notecard note-c library
#include <note.h>

// Notecard node-c helper methods
#include "note_c_hooks.h"

// Uncomment the define below and replace com.your-company:your-product-name
// with your ProductUID.
// #define PRODUCT_UID "com.your-company:your-product-name"

#ifndef PRODUCT_UID
#define PRODUCT_UID ""
#pragma message "PRODUCT_UID is not defined in this example. Please ensure your Notecard has a product identifier set before running this example or define it in code here. More details at https://bit.ly/product-uid"
#endif

// Uncomment to communicate with the Notecard over Serial
#define USE_SERIAL

// 10000 msec = 10 sec
#define SLEEP_TIME_MS 10000

// The devicetree node identifier for the "led0" alias.
#define LED0_NODE DT_ALIAS(led0)

#define MY_CLK_HSI48 DT_NODELABEL(clk_hsi48)
#if DT_NODE_HAS_STATUS(MY_CLK_HSI48, okay)
const struct device *const hsi48 = DEVICE_DT_GET(MY_CLK_HSI48);
#else
#error "HSI clock is disabled"
#endif

// A build error on this line means your board is unsupported.
// See the sample documentation for information on how to fix this.
static const struct gpio_dt_spec led = GPIO_DT_SPEC_GET(LED0_NODE, gpios);

void main(void)
{
    int ret;

    // Initialize note-c hooks
    NoteSetUserAgent((char *)"note-zephyr");
    NoteSetFnDefault(malloc, free, platform_delay, platform_millis);
    NoteSetFnDebugOutput(note_log_print);
#ifdef USE_SERIAL
    NoteSetFnSerial(note_serial_reset, note_serial_transmit,
                    note_serial_available, note_serial_receive);
#else
    NoteSetFnI2C(NOTE_I2C_ADDR_DEFAULT, NOTE_I2C_MAX_DEFAULT, note_i2c_reset,
                 note_i2c_transmit, note_i2c_receive);
#endif

    // Send a Notecard hub.set using note-c
    J *req = NoteNewRequest("hub.set");
    if (req)
    {
        JAddStringToObject(req, "product", PRODUCT_UID);
        JAddStringToObject(req, "mode", "continuous");
        JAddStringToObject(req, "sn", "zephyr-blink");
        if (!NoteRequest(req))
        {
            printk("Failed to configure Notecard.\n");
            return;
        }
    }
    else
    {
        printk("Failed to allocate memory.\n");
        return;
    }

    if (!gpio_is_ready_dt(&led))
    {
        printk("Failed to activate LED.\n");
        return;
    }

    ret = gpio_pin_configure_dt(&led, GPIO_OUTPUT_ACTIVE);
    if (ret < 0)
    {
        printk("Failed to configure LED.\n");
        return;
    }

    // Application Loop
    while (1)
    {
        // Toggle LED state
        ret = gpio_pin_toggle_dt(&led);
        if (ret < 0)
        {
            printk("Failed to toggle LED.\n");
            return;
        }

        // Report LED state to Notehub.io
        J *req = NoteNewRequest("note.add");
        if (req)
        {
            JAddBoolToObject(req, "sync", true);
            J *body = JAddObjectToObject(req, "body");
            JAddBoolToObject(body, "LED", gpio_pin_get(led.port, led.pin));
            if (!NoteRequest(req))
            {
                printk("Failed to submit Note to Notecard.\n");
                return;
            }
        }
        else
        {
            printk("Failed to allocate memory.\n");
            return;
        }

        // Wait to iterate
        k_msleep(SLEEP_TIME_MS);
    }
}
```

## src/note_c_hooks.c
```c
#include "note_c_hooks.h"

#include <zephyr/drivers/i2c.h>
#include <zephyr/drivers/uart.h>
#include <zephyr/kernel.h>

static const size_t REQUEST_HEADER_SIZE = 2;
static const uint16_t SERIAL_PEEK_EMPTY_MASK = 0xFF00;

const struct device *i2c_dev = NULL;
bool i2c_initialized = false;

const struct device *serial_dev = NULL;
bool serial1_initialized = false;
uint16_t serial_peek_buffer = SERIAL_PEEK_EMPTY_MASK;

const char *note_i2c_receive(uint16_t device_address_, uint8_t *buffer_, uint16_t size_, uint32_t *available_) {
    // Let the Notecard know that we are getting ready to read some data
    uint8_t size_buf[2];
    size_buf[0] = 0;
    size_buf[1] = (uint8_t)size_;
    uint8_t write_result = i2c_write(i2c_dev, size_buf, sizeof(size_buf), device_address_);

    if (write_result != 0) {
        return "i2c: Unable to initate read from the Notecard\n";
    }

    // Read from the Notecard and copy the response bytes into the response buffer
    const int request_length = size_ + REQUEST_HEADER_SIZE;
    uint8_t read_buf[256];
    uint8_t read_result = i2c_read(i2c_dev, read_buf, request_length, device_address_);

    if (read_result != 0) {
        return "i2c: Unable to receive data from the Notecard.\n";
    } else {
        *available_ = (uint32_t)read_buf[0];
        uint8_t bytes_to_read = read_buf[1];
        for (size_t i = 0; i < bytes_to_read; i++) {
            buffer_[i] = read_buf[i + 2];
        }

        return NULL;
    }
}

bool note_i2c_reset(uint16_t device_address_) {
    (void)device_address_;

    if (i2c_initialized) {
        return true;
    }

    if (!i2c_dev) {
        i2c_dev = DEVICE_DT_GET(DT_NODELABEL(i2c1));
    }

    if (!device_is_ready(i2c_dev)) {
        printk("i2c: Device is not ready.\n");
        return false;
    }

    printk("i2c: Device is ready.\n");

    i2c_initialized = true;
    return true;
}

const char *note_i2c_transmit(uint16_t device_address_, uint8_t *buffer_, uint16_t size_) {
    // Create a buffer that contains the number of bytes and the data to write to the Notecard
    uint8_t write_buf[size_ + 1];
    write_buf[0] = (uint8_t)size_;
    for (size_t i = 0; i < size_; i++) {
        write_buf[i + 1] = buffer_[i];
    }

    // Write the message
    uint8_t write_result = i2c_write(i2c_dev, write_buf, sizeof(write_buf), device_address_);

    if (write_result != 0) {
        return "i2c: Unable to transmit data to the Notecard\n";
    } else {
        return NULL;
    }
}

size_t note_log_print(const char *message_) {
    if (message_) {
        printk("%s", message_);
        return 1;
    }

    return 0;
}

bool note_serial_available(void)
{
    bool result;

    if (SERIAL_PEEK_EMPTY_MASK & serial_peek_buffer)
    {
        unsigned char next_char;
        int status = uart_poll_in(serial_dev, &next_char);
        switch (status)
        {
        case 0:
            serial_peek_buffer = next_char;
            result = true;
            break;
        case -1:
            // No character was available to read
            // fallthrough
        case -ENOSYS:
            // The operation was not implemented
            // fallthrough
        case -EBUSY:
            // Async reception was enabled using `uart_rx_enable`
            // fallthrough
        default:
            result = false;
            break;
        }
    }
    else
    {
        result = true;
    }

    return result;
}

char note_serial_receive(void)
{
    char result;

    if (!(SERIAL_PEEK_EMPTY_MASK & serial_peek_buffer))
    {
        // Peek buffer is NOT empty
        result = serial_peek_buffer;
        serial_peek_buffer = SERIAL_PEEK_EMPTY_MASK;
    }
    else if (uart_poll_in(serial_dev, (unsigned char *)&result))
    {
        result = '\0';
    }

    return result;
}

bool note_serial_reset(void)
{
    bool result;

    if (serial1_initialized)
    {
        // Empty buffer
        for (char c; !uart_poll_in(serial_dev, &c);)
            ;
        result = true;
    }
    else
    {
        if (!serial_dev)
        {
            serial_dev = DEVICE_DT_GET(DT_NODELABEL(usart1));
        }
        struct uart_config serial_cfg = {
            .baudrate = 9600,
            .parity = UART_CFG_PARITY_NONE,
            .stop_bits = UART_CFG_STOP_BITS_1,
            .data_bits = UART_CFG_DATA_BITS_8,
            .flow_ctrl = UART_CFG_FLOW_CTRL_NONE};
        if (uart_configure(serial_dev, &serial_cfg))
        {
            printk("serial: Failed to configure device.\n");
            serial1_initialized = false;
            result = false;
        }
        else if (!device_is_ready(serial_dev))
        {
            printk("serial: Device is not ready.\n");
            serial1_initialized = false;
            result = false;
        }
        else
        {
            printk("serial: Device is ready.\n");
            serial1_initialized = true;
            result = true;
        }
    }

    return result;
}

void note_serial_transmit(uint8_t *text_, size_t len_, bool flush_)
{
    (void)flush_; // `uart_poll_out` blocks (i.e. always flushes)

    for (size_t i = 0; i < len_; ++i)
    {
        uart_poll_out(serial_dev, text_[i]);
    }
}

void platform_delay(uint32_t ms) {
    k_msleep(ms);
}

uint32_t platform_millis(void) {
    return (uint32_t)k_uptime_get();
}
```

## src/note_c_hooks.h
```c
#ifndef NOTE_C_HOOKS_H
#define NOTE_C_HOOKS_H

#include <stdbool.h>
#include <stdint.h>
#include <stdlib.h>

const char *note_i2c_receive(uint16_t device_address_, uint8_t *buffer_, uint16_t size_, uint32_t *available_);
bool note_i2c_reset(uint16_t device_address_);
const char *note_i2c_transmit(uint16_t device_address_, uint8_t *buffer_, uint16_t size_);

size_t note_log_print(const char *message_);

bool note_serial_available(void);
char note_serial_receive(void);
bool note_serial_reset(void);
void note_serial_transmit(uint8_t *text_, size_t len_, bool flush_);

void platform_delay(uint32_t ms);
uint32_t platform_millis(void);

#endif // NOTE_C_HOOKS_H
```

## src/notecard.c
```c
#include "notecard.h"

#include <zephyr/drivers/i2c.h>
#include <zephyr/drivers/uart.h>
#include <zephyr/kernel.h>

static const size_t REQUEST_HEADER_SIZE = 2;

const struct device *i2c_dev = NULL;
bool i2c1_initialized = false;

uint32_t platform_millis(void)
{
    return (uint32_t)k_uptime_get();
}

void platform_delay(uint32_t ms)
{
    k_msleep(ms);
}

const char *noteI2cReceive(uint16_t device_address_, uint8_t *buffer_, uint16_t size_, uint32_t *available_)
{
    // Let the Notecard know that we are getting ready to read some data
    uint8_t size_buf[2];
    size_buf[0] = 0;
    size_buf[1] = (uint8_t)size_;
    uint8_t write_result = i2c_write(i2c_dev, size_buf, sizeof(size_buf), device_address_);

    if (write_result != 0)
    {
        return "i2c: Unable to initate read from the Notecard\n";
    }

    // Read from the Notecard and copy the response bytes into the response buffer
    const int request_length = size_ + REQUEST_HEADER_SIZE;
    uint8_t read_buf[256];
    uint8_t read_result = i2c_read(i2c_dev, read_buf, request_length, device_address_);

    if (read_result != 0)
    {
        return "i2c: Unable to receive data from the Notecard.\n";
    }
    else
    {
        *available_ = (uint32_t)read_buf[0];
        uint8_t bytes_to_read = read_buf[1];
        for (size_t i = 0; i < bytes_to_read; i++)
        {
            buffer_[i] = read_buf[i + 2];
        }

        return NULL;
    }
}

bool noteI2cReset(uint16_t device_address_)
{
    (void)device_address_;

    if (i2c1_initialized)
        return true;

    if (!i2c_dev)
    {
        i2c_dev = DEVICE_DT_GET(DT_NODELABEL(i2c1));
    }

    if (!device_is_ready(i2c_dev))
    {
        printk("i2c: Device is not ready.\n");

        return false;
    }

    printk("i2c: Device is ready.\n");

    i2c1_initialized = true;
    return true;
}

const char *noteI2cTransmit(uint16_t device_address_, uint8_t *buffer_, uint16_t size_)
{
    // Create a buffer that contains the number of bytes and the data to write to the Notecard
    uint8_t write_buf[size_ + 1];
    write_buf[0] = (uint8_t)size_;
    for (size_t i = 0; i < size_; i++)
    {
        write_buf[i + 1] = buffer_[i];
    }

    // Write the message
    uint8_t write_result = i2c_write(i2c_dev, write_buf, sizeof(write_buf), device_address_);

    if (write_result != 0)
    {
        return "i2c: Unable to transmit data to the Notecard\n";
    }
    else
    {
        return NULL;
    }
}

size_t noteLogPrint(const char *message_)
{
    if (message_)
    {
        printk("%s", message_);
        return 1;
    }

    return 0;
}

bool noteSerialAvailable(void)
{
    bool result = false;

    return result;
}

char noteSerialReceive(void)
{
    char result = 'z';

    return result;
}

bool noteSerialReset(void)
{
    bool result = false;

    return result;
}

void noteSerialTransmit(uint8_t *text_, size_t len_, bool flush_)
{
}
```

## src/notecard.h
```c
#ifndef NOTECARD_H
#define NOTECARD_H

#include <stdbool.h>
#include <stdint.h>
#include <stdlib.h>

void platform_delay(uint32_t ms);
uint32_t platform_millis(void);
const char *noteI2cReceive(uint16_t device_address_, uint8_t *buffer_, uint16_t size_, uint32_t *available_);
bool noteI2cReset(uint16_t device_address_);
const char *noteI2cTransmit(uint16_t device_address_, uint8_t *buffer_, uint16_t size_);
size_t noteLogPrint(const char * message_);

#endif // NOTECARD_H
```
