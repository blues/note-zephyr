## CMakeLists.txt
```
# Copyright (c) 2025 Blues Inc.
# SPDX-License-Identifier: MIT

cmake_minimum_required(VERSION 3.13.1)
find_package(Zephyr REQUIRED HINTS $ENV{ZEPHYR_BASE})

project(app LANGUAGES C)

# Generate blues_logo.h from the PNG at configure time.
# PYTHON_EXECUTABLE is set by Zephyr's CMake modules; fall back to finding
# Python3 explicitly if this file is ever used outside a Zephyr build.
if(NOT PYTHON_EXECUTABLE)
    find_package(Python3 REQUIRED COMPONENTS Interpreter)
    set(PYTHON_EXECUTABLE ${Python3_EXECUTABLE})
endif()

set(BLUES_LOGO_H ${CMAKE_CURRENT_BINARY_DIR}/blues_logo.h)
execute_process(
    COMMAND ${PYTHON_EXECUTABLE}
            ${CMAKE_CURRENT_SOURCE_DIR}/scripts/png_to_header.py
            ${CMAKE_CURRENT_SOURCE_DIR}/blues_logo.png
            ${BLUES_LOGO_H}
            blues_logo_png
    RESULT_VARIABLE result
)
if(NOT result EQUAL 0)
    message(FATAL_ERROR "Failed to generate blues_logo.h from blues_logo.png")
endif()
target_include_directories(app PRIVATE ${CMAKE_CURRENT_BINARY_DIR})

target_sources(app PRIVATE src/main.c)
```

## prj.conf
```kconfig
# Logging
CONFIG_LOG=y

# Notecard libraries
CONFIG_NEWLIB_LIBC=y # Required by `note-c`
CONFIG_BLUES_NOTECARD=y
# Optional: Enable Notecard logging
CONFIG_BLUES_NOTECARD_LOGGING=y

# Heap must be large enough for the COBS-encoded receive buffer (~4875 bytes for
# the 4854-byte Blues logo payload). 8192 gives comfortable headroom.
CONFIG_HEAP_MEM_POOL_SIZE=8192
```

## src/main.c
```c
/*
 * Copyright (c) 2025 Blues Inc.
 *
 * MIT License. Use of this source code is governed by licenses granted
 * by the copyright holder including that found in the LICENSE file.
 */

#include <zephyr/kernel.h>
#include <zephyr/logging/log.h>
#include <string.h>

#include <note.h>
#include "blues_logo.h"

#ifndef PRODUCT_UID
#define PRODUCT_UID ""
#pragma message "PRODUCT_UID is not defined in this example. Please ensure your Notecard has a product identifier set before running this example or define it in code here. More details at https://bit.ly/product-uid"
#endif

#define SLEEP_TIME_MS 30000
#define MAX_ITERATIONS 5

LOG_MODULE_REGISTER(main);

int main(void)
{
    LOG_INF("Initializing binary send/receive example...");

    // Configure the Notecard
    J *req = NoteNewRequest("hub.set");
    if (req) {
        JAddStringToObject(req, "product", PRODUCT_UID);
        JAddStringToObject(req, "mode", "continuous");
        if (!NoteRequest(req)) {
            LOG_ERR("Failed to configure Notecard.");
            return -1;
        }
    } else {
        LOG_ERR("Failed to allocate memory for hub.set request.");
        return -1;
    }

    // Reset the binary store
    const char *err = NoteBinaryStoreReset();
    if (err != NULL) {
        LOG_ERR("Failed to reset binary store: %s", err);
        return -1;
    }

    uint8_t event_counter = 0;
    while (1) {
        if (++event_counter > MAX_ITERATIONS) {
            LOG_INF("Demo complete. Program stopping to conserve data.");
            return 0;
        }

        const uint32_t notecard_binary_area_offset = 0;

        // NoteBinaryStoreTransmit encodes in-place, so it needs a mutable buffer
        // large enough for the COBS-encoded output, with the raw data at the start.
        uint32_t tx_buffer_len = NoteBinaryCodecMaxEncodedLength(blues_logo_png_len);
        uint8_t *tx_buffer = k_malloc(tx_buffer_len);
        if (!tx_buffer) {
            LOG_ERR("Failed to allocate transmit buffer");
            k_msleep(SLEEP_TIME_MS);
            continue;
        }
        memcpy(tx_buffer, blues_logo_png, blues_logo_png_len);

        err = NoteBinaryStoreTransmit(tx_buffer, blues_logo_png_len, tx_buffer_len, notecard_binary_area_offset);
        k_free(tx_buffer);
        if (err != NULL) {
            LOG_ERR("Failed to transmit binary data: %s", err);
            NoteBinaryStoreReset();
            k_msleep(SLEEP_TIME_MS);
            continue;
        }
        LOG_INF("Transmitted %u bytes", blues_logo_png_len);

        // Receive data length from Notecard storage
        uint32_t rx_data_len = 0;
        err = NoteBinaryStoreDecodedLength(&rx_data_len);
        if (err != NULL) {
            LOG_ERR("Failed to get decoded length: %s", err);
            NoteBinaryStoreReset();
            k_msleep(SLEEP_TIME_MS);
            continue;
        }

        // Allocate receive buffer
        uint32_t rx_buffer_len = NoteBinaryCodecMaxEncodedLength(rx_data_len);
        uint8_t *rx_buffer = k_malloc(rx_buffer_len);
        if (!rx_buffer) {
            LOG_ERR("Failed to allocate receive buffer");
            NoteBinaryStoreReset();
            k_msleep(SLEEP_TIME_MS);
            continue;
        }

        // Receive the actual data from Notecard storage
        err = NoteBinaryStoreReceive(rx_buffer, rx_buffer_len, 0, rx_data_len);
        if (err != NULL) {
            LOG_ERR("Failed to receive binary data: %s", err);
            k_free(rx_buffer);
            NoteBinaryStoreReset();
            k_msleep(SLEEP_TIME_MS);
            continue;
        }

        // Verify the round-trip
        if (rx_data_len != blues_logo_png_len ||
            memcmp(rx_buffer, blues_logo_png, blues_logo_png_len) != 0) {
            LOG_ERR("Round-trip verification failed");
            k_free(rx_buffer);
            NoteBinaryStoreReset();
            k_msleep(SLEEP_TIME_MS);
            continue;
        }
        LOG_INF("Round-trip verified: %u bytes match", rx_data_len);

        k_free(rx_buffer);

        // Send binary data to Notehub
        req = NoteNewRequest("note.add");
        if (req) {
            JAddStringToObject(req, "file", "data.qo");
            JAddBoolToObject(req, "binary", true);
            JAddBoolToObject(req, "live", true);
            if (!NoteRequest(req)) {
                LOG_ERR("Failed to send binary note to Notehub");
                NoteBinaryStoreReset();
            } else {
                LOG_INF("Binary note sent to Notehub");
            }
        } else {
            LOG_ERR("Failed to allocate memory for note.add request");
            NoteBinaryStoreReset();
        }

        k_msleep(SLEEP_TIME_MS);
    }

    return 0;
}
```
